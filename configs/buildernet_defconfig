## configs/buildernet_defconfig
```kconfig
# Architecture
BR2_x86_64=y
BR2_TARGET_GENERIC_ROOT_PASSWD="FlashBotsBuilderNode"


# Toolchain settings
BR2_TOOLCHAIN_BUILDROOT_GLIBC=y
BR2_TOOLCHAIN_BUILDROOT_GLIBC=y
BR2_TOOLCHAIN_HAS_CXX=y
BR2_TOOLCHAIN_BUILDROOT_CXX=y
BR2_TOOLCHAIN_BUILDROOT=y
BR2_INSTALL_LIBSTDCPP=y
BR2_PACKAGE_LIBSIGC=y
BR2_PACKAGE_OPENSSL=y
BR2_PACKAGE_LIBOPENSSL_BIN=y
BR2_PACKAGE_CA_CERTIFICATES=y

# System configuration
BR2_INIT_SYSTEMD=y      
BR2_TARGET_GENERIC_HOSTNAME="buildernet"
BR2_TARGET_GENERIC_ISSUE="buildernet ethereum node"
BR2_TARGET_GENERIC_GETTY_PORT="tty1"

# Kernel
BR2_LINUX_KERNEL=y
BR2_LINUX_KERNEL_CUSTOM_VERSION=y
BR2_LINUX_KERNEL_CUSTOM_VERSION_VALUE="6.1.131"
BR2_LINUX_KERNEL_DEFCONFIG="x86_64"  
BR2_LINUX_KERNEL_INSTALL_TARGET=y   
BR2_KERNEL_HEADERS_6_1=y

# Bootloader
BR2_TARGET_GRUB2=y
BR2_TARGET_GRUB2_I386_PC=y
BR2_TARGET_GRUB2_INSTALL_TOOLS=y

# Host utilities for image creation
BR2_PACKAGE_HOST_GENIMAGE=y

# Filesystem images
BR2_TARGET_ROOTFS_EXT2=y
BR2_TARGET_ROOTFS_EXT2_4=y
BR2_TARGET_ROOTFS_EXT2_SIZE="512M"
BR2_ROOTFS_OVERLAY="rootfs-overlay"
 
# Post-image script to generate final disk image with multiple partitions:
BR2_ROOTFS_POST_IMAGE_SCRIPT="board/buildernet/genimage.sh"

# Network
BR2_SYSTEMD_NETWORKD=y
BR2_PACKAGE_SYSTEMD_NETWORKD=y
BR2_SYSTEMD_RESOLVE=y
BR2_PACKAGE_IPTABLES=y

#SSH
#BR2_PACKAGE_OPENSSH=y
#BR2_PACKAGE_OPENSSH_SERVER=y
#BR2_PACKAGE_OPENSSH_CLIENT=y
#BR2_PACKAGE_OPENSSH_KEY_UTILS=y
#BR2_PACKAGE_OPENSSH_KEYGEN=y
```
